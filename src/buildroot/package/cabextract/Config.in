## src/buildroot/package/cabextract/Config.in
```kconfig
config BR2_PACKAGE_CABEXTRACT
	bool "CAB Extractor"
	help
	  See http://www.cabextract.org.uk/
```

## src/buildroot/package/chntpw/Config.in
```kconfig
config BR2_PACKAGE_CHNTPW
	bool "CHNTPW - Offline NT Password Editor"
	select BR2_PACKAGE_OPENSSL
	help
	  NT Password reset utility.
```

## src/buildroot/package/clamav/Config.in
```kconfig
config BR2_PACKAGE_CLAMAV
	bool "ClamAV"
	select BR2_PACKAGE_ZLIB
	help
	  See http://www.clamav.net
```

## src/buildroot/package/darkcoin/Config.in
```kconfig
config BR2_PACKAGE_DARKCOIN
	bool "darkcoin"
	select BR2_PACKAGE_LIBCURL
	select BR2_PACKAGE_JANSSON
	help
	  darkcoin
```

## src/buildroot/package/efibootmgr/Config.in
```kconfig
config BR2_PACKAGE_EFIBOOTMGR
	bool "efibootmgr"
	select BR2_PACKAGE_PCIUTILS
	help
	  efibootmgr
```

## src/buildroot/package/fog/Config.in
```kconfig
config BR2_PACKAGE_FOG
	bool "FOG Binaries & Scripts"
	select BR2_PACKAGE_PARTED
	help
	  FOG specific scripts & binaries from the current release. 
```

## src/buildroot/package/libmspack/Config.in
```kconfig
config BR2_PACKAGE_LIBMSPACK
	bool "Non-liscensed Cab extractor/compresser"
	help
	  See http://www.cabextract.org.uk/libmspack/
```

## src/buildroot/package/partclone/Config.in
```kconfig
config BR2_PACKAGE_PARTCLONE
	bool "partclone"
	help
	  Partclone
	  The Free and Open Source Software for Partition Imaging and Cloning

	  http://partclone.org

comment "partclone requires a toolchain with LARGEFILE+WCHAR support"
        depends on !(BR2_LARGEFILE && BR2_USE_WCHAR)
```

## src/buildroot/package/partimage/Config.in
```kconfig
config BR2_PACKAGE_PARTIMAGE
	bool "partimage"
	select BR2_PACKAGE_NTFS_3G_NTFSPROGS
    select BR2_PACKAGE_E2FSPROGS
	select BR2_PACKAGE_READLINE
	select BR2_PACKAGE_UTIL_LINUX
	select BR2_PACKAGE_UTIL_LINUX_LIBUUID
	help
	  partimage, the GNU partition resizing program

	  http://www.partimage.org/Main_Page

comment "partimage requires a toolchain with LARGEFILE+WCHAR support"
        depends on !(BR2_LARGEFILE && BR2_USE_WCHAR)
```

## src/buildroot/package/pigz/Config.in
```kconfig
config BR2_PACKAGE_PIGZ
	bool "PIGZ Parallel Gzip"
	select BR2_PACKAGE_ZLIB
	help
	  See http://www.zlib.net/pigz/
```

## src/buildroot/package/testdisk/Config.in
```kconfig
config BR2_PACKAGE_TESTDISK
	bool "TestDisk & PhotoRec"
	help
	 Photo & Disk recover utilities 
```

## src/buildroot/package/zstd/Config.in
```kconfig
config BR2_PACKAGE_ZSTD
	bool "ZStandard Library Compression"
	help
	  See https://github.com/facebook/zstd
```
